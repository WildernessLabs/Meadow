## configs/stm32f777zit6-meadow/Kconfig
```kconfig
#
# For a description of the syntax of this configuration file,
# see the file kconfig-language.txt in the NuttX tools repository.
#

config HCOM_FILESYSTEM_INIT
    bool "Enables HCOM FS initialization support"
    default y

config HCOM_MTD_STRESS_TEST
    bool "Enables HCOM MTD stress testing support"
    default n

config HCOM_MONO_OUTPUT_PIPE
    bool "Enables HCOM Mono output pipe support"
    default n

config HCOM_MONO_DEBUG_PIPE
    bool "Enables HCOM Mono debug pipe support"
    default n

config HCOM_COMMS_DEVICE_NAME
    string "Specifies the device name for HCOM communications"
    default "/dev/ttyACM0"

config HCOM_ESP32_COMMS
    bool "Enables HCOM to communicate with the ESP32"
    default y

menu "ESP32 Coprocessor Configuration"
source "configs/stm32f777zit6-meadow/src/espcp/Kconfig"
endmenu

if ARCH_BOARD_MEADOW

# See meadow-adc.c file, currently unused.
config MEADOW_ADC
    bool "Enables Meadow ADC support"

config MEADOW_HCOM
    bool "Enables Meadow HCOM support"
    default y

endif # ARCH_BOARD_MEADOW
```

## configs/stm32f777zit6-meadow/src/espcp/Kconfig
```kconfig
#
# For a description of the syntax of this configuration file,
# see the file kconfig-language.txt in the NuttX tools repository.
#

config MEADOW_ESPCP_MANAGER
    bool "Enable ESP32 Coprocessor"
    default y
    ---help---
        Enable or disable ESP32 coprocessor support.

if MEADOW_ESPCP_MANAGER

config MEADOW_ESPCP_PRIORITY
    int "ESP32 coprocessor queue manager task priority"
    default 100
    ---help---
        Message queue priority for messages to be sent to the ESP32

config MEADOW_ESPCP_STACKSIZE
    int "ESP32 coprocessor stack size"
    default 4096
    ---help---
        Amount of memory reserved for the process dealing with messages for / from the ESP32.

config MEADOW_ESP32CP_USE_EXTERNAL_ESP32_BOARD
    bool "Use external ESP32 chip"
    default n
    ---help---
        Use an external ESP32 for debugging purposes.

endif
```

## examples/esp32spicommstest/Kconfig
```kconfig
#
# For a description of the syntax of this configuration file,
# see misc/tools/kconfig-language.txt.
#

config EXAMPLES_ESP32SPICOMMSTEST
	tristate "ESP32 SPI Comms test example"
	default n
	depends on NET && NET_USRSOCK && !DISABLE_POLL
	select NET_USRSOCK_TCP
	select NET_USRSOCK_UDP
	select NET_SOCKOPTS
	select PIPES
	---help---
		Enable the User Socket test example. This example application runs
		unit-tests for ESP32 SPI Communications messaging test.

if EXAMPLES_ESP32SPICOMMSTEST

config EXAMPLES_ESP32SPICOMMSTEST_PROGNAME
	string "Program name"
	default "esp32spicommstest"
	depends on BUILD_LOADABLE
	---help---
		This is the name of the program that will be use when the NSH ELF
		program is installed.

config EXAMPLES_ESP32SPICOMMSTEST_PRIORITY
	int "ESP32 SPI Communication test task priority"
	default 100

config EXAMPLES_ESP32SPICOMMSTEST_STACKSIZE
	int "ESP32 SPI Communication test stack size"
	default 4096

endif
```

## nuttx/configs/Kconfig
```kconfig
#
# For a description of the syntax of this configuration file,
# see the file kconfig-language.txt in the NuttX tools repository.
#

choice
	prompt "Select target board"
	default ARCH_BOARD_CUSTOM
	---help---
		Select the board hosting the architecture.  You must first select the
		exact MCU part number, then the boards supporting that part will
		be available for selection.  Use ARCH_BOARD_CUSTOM to create a new
		board configuration.

config ARCH_BOARD_SIM
	bool "User mode simulation"
	depends on ARCH_SIM
	---help---
		A user-mode port of NuttX to the x86 Linux/Cygwin platform is available.
		The purpose of this port is primarily to support OS feature development.
		This port does not support interrupts or a real timer (and hence no
		round robin scheduler)  Otherwise, it is complete.

config ARCH_BOARD_CUSTOM
	bool "Custom development board"
	---help---
		Select this option if there is no directory for the board under configs/.

		Cannot see the board you want?  You must first select the exact MCU part
		number, then the boards supporting that part will be available for selection.

config ARCH_BOARD_MEADOW
	bool "Meadow board"
	depends on ARCH_CHIP_STM32F777ZI
	---help---
		Meadow board

endchoice

if ARCH_BOARD_CUSTOM
menu "Custom Board Configuration"

config ARCH_BOARD_CUSTOM_NAME
	string "Custom board name"
	default ""
	---help---
		This is a name for the board.  It is not used except to return the
		information via the NSH uname command.

config ARCH_BOARD_CUSTOM_DIR
	string "Custom board directory"
	default ""
	---help---
		If the custom board configuration is selected, then it is necessary
		to also tell the build system where it can find the board directory
		for the custom board.

		In this case, the board directory is assume to lie outside the
		NuttX directory.  The provided path must then be a full, absolute
		path to some location outside of the NuttX source tree (like
		"~/projects/myboard").

config ARCH_BOARD_CUSTOM_DIR_RELPATH
	bool "Relative custom board directory"
	default y
	---help---
		Specifies that the board directory is relative to the NuttX directory.

config BOARD_CUSTOM_LEDS
	bool "Custom board LEDs"
	default n
	select ARCH_HAVE_LEDS

config BOARD_CUSTOM_BUTTONS
	bool "Custom board buttons"
	default n
	select ARCH_HAVE_BUTTONS
	select ARCH_BUTTONS

config BOARD_CUSTOM_IRQBUTTONS
	bool "Custom Board IRQ buttons"
	default n
	depends on BOARD_CUSTOM_BUTTONS
	select ARCH_HAVE_IRQBUTTONS
	select ARCH_IRQBUTTONS

config BOARD_CUSTOM_INTERRUPT
	bool "Custom board PHY interrupts"
	default n
	depends on NETDEVICES
	select ARCH_PHY_INTERRUPT if NETDEVICES

endmenu # Custom Board Configuration
endif #ARCH_BOARD_CUSTOM

config ARCH_BOARD
	string
	default "sim"                      if ARCH_BOARD_SIM
	default "stm32f777zit6-meadow"     if ARCH_BOARD_MEADOW

comment "Common Board Options"

config ARCH_HAVE_LEDS
	bool

config ARCH_LEDS
	bool "Board LED Status support"
	default y
	depends on ARCH_HAVE_LEDS
	---help---
		Use board LEDs to show NuttX execution status state. Unique to boards that have LEDs

config ARCH_HAVE_BUTTONS
	bool

config ARCH_BUTTONS
	bool "Board button support"
	default n
	depends on ARCH_HAVE_BUTTONS
	---help---
		"Support interfaces to use buttons provided by the board."

config ARCH_HAVE_IRQBUTTONS
	bool

config ARCH_IRQBUTTONS
	bool "Button interrupt support"
	default n
	depends on ARCH_BUTTONS && ARCH_HAVE_IRQBUTTONS
	---help---
		"Support interrupts on button presses and releases."

comment "Board-Specific Options"


if ARCH_BOARD_SIM
source "configs/sim/Kconfig"
endif
if ARCH_BOARD_CUSTOM
source "configs/dummy/Kconfig"
endif
if ARCH_BOARD_MEADOW
source "configs/stm32f777zit6-meadow/Kconfig"
endif

config BOARD_CRASHDUMP
	bool "Enable Board level logging of crash dumps"
	default n
	---help---
		If selected up_assert will call out to board_crashdump, in the case
		of an assertion failure, prior to calling exit. Or in the
		case of a hardfault prior to looping indefinitely. board_crashdump
		then has a chance to save the state of the machine.

		The purpose of board_crashdump is to save as much information as it can
		about the cause of the fault and then most likely reset the system.

		 N.B. There is limited system resources that can be used, who knows
		 what memory is trashed? So all we can expect to do is save the
		"machine state" in a place where on the next reset can write it
		to more sophisticated storage in a sane operating environment.

config BOARD_ENTROPY_POOL
	bool "Enable Board level storing of entropy pool structure"
	default n
	depends on CRYPTO_RANDOM_POOL
	---help---
		Entropy pool structure can be provided by board source.
		Use for this is, for example, to allocate entropy pool
		from special area of RAM which content is kept over
		system reset.

config BOARD_INITRNGSEED
	bool "Enable Board level initial seeding of entropy pool RNG"
	default n
	depends on CRYPTO_RANDOM_POOL
	---help---
		If enabled, entropy pool random number generator will call
		board_init_rndseed() upon initialization. This function
		can then provide early entropy seed to the pool through
		entropy injection APIs provided at 'nuttx/random.h'.

config LIB_BOARDCTL
	bool "Enable boardctl() interface"
	default n
	---help---
		Enables support for the boardctl() interface.  Architecture
		specific logic must provide board_app_initialize() interface.

if LIB_BOARDCTL

config BOARDCTL_FINALINIT
	bool "Enable board app final init"
	default n
	---help---
		Enables support for the BOARDIOC_FINALINIT boardctl() command.
		Architecture specific logic must provide board_app_finalinitialize()
		interface.

config BOARDCTL_POWEROFF
	bool "Enable power off interfaces"
	default n
	depends on ARCH_HAVE_POWEROFF
	---help---
		Enables support for the BOARDIOC_POWEROFF boardctl() command.
		Architecture specific logic must provide the board_power_off()
		interface.

config BOARDCTL_RESET
	bool "Enable reset interfaces"
	default n
	depends on ARCH_HAVE_RESET
	---help---
		Enables support for the BOARDIOC_RESET boardctl() command.
		Architecture specific logic must provide the board_reset()
		interface.

config BOARD_RESET_ON_ASSERT
	int "Enable Board Reset after assert"
	default 0
	depends on BOARDCTL_RESET
	---help---
		== 0 up_assert never reset the machine
		>= 1 up_assert from interrupt handler or IDLE thread will reset the
		     machine
		>= 2 up_assert from user or kernel thread will reset the machine.
		     The default behavior is just to kill the asserting thread.

config BOARD_ASSERT_RESET_VALUE
	int "Board reset argument"
	default 0
	depends on BOARDCTL_RESET
	---help---
		Parameter that will be passed to board_reset() by when an
		assertion occurs.  This may be used by board_reset()
		implementations to handle the reset differently for the
		case of a crash.

config BOARDCTL_UNIQUEID
	bool "Return board unique ID"
	default n
	---help---
		Enables support for the BOARDIOC_UNIQUEID boardctl() command.
		Architecture specific logic must provide the board_uniqueid()
		interface.

config BOARDCTL_UNIQUEID_SIZE
	int "Size of the board unique ID (bytes)"
	default 16
	depends on BOARDCTL_UNIQUEID
	---help---
		Provides the size of the memory buffer that must be provided by the
		caller of board_uniqueid() in which to receive the board unique ID.

config BOARDCTL_APP_SYMTAB
	bool "Enable application symbol table interfaces"
	default n
	---help---
		Enables support for the BOARDIOC_APP_SYMTAB boardctl() command.

config BOARDCTL_OS_SYMTAB
	bool "Enable kernel module symbol table interfaces"
	default n
	depends on MODULE
	---help---
		Enables support for the BOARDIOC_OS_SYMTAB boardctl() command.

config BOARDCTL_USBDEVCTRL
	bool "Enable USB device controls"
	default n
	depends on USBDEV
	---help---
		Enables support for the BOARDIOC_USBDEV_CONTROL boardctl() command.

config BOARDCTL_TESTSET
	bool "Architecture-specific test/set operation"
	default n
	---help---
		Enables support for the BOARDIOC_SPINLOCK boardctl() command.
		Architecture specific logic must provide up_testset() interface.

config BOARDCTL_IOCTL
	bool "Board-specific boardctl() commands"
	default n
	---help---
		Enables support for the BOARDIOC_POWEROFF boardctl() command.
		Architecture specific logic must provide board_ioctl() interface.

endif # LIB_BOARDCTL
```

## nuttx/configs/stm32f777zit6-meadow/Kconfig
```kconfig
#
# For a description of the syntax of this configuration file,
# see the file kconfig-language.txt in the NuttX tools repository.
#

config HCOM_FILESYSTEM_INIT
    bool "Enables HCOM FS initialization support"
    default y

config HCOM_MTD_STRESS_TEST
    bool "Enables HCOM MTD stress testing support"
    default n

config HCOM_MONO_STDERR_STDOUT
    bool "Enables HCOM routing of Mono stdout and stderr to PC/Mac"
    default y

config HCOM_MONO_REMOTE_DEBUGGING
    bool "Enables HCOM Mono remote debugging support"
    default y

config HCOM_COMMS_DEVICE_NAME
    string "Specifies the device name for HCOM communications"
    default "/dev/ttyACM0"

config MEADOW_CLOUD
    bool "Enables Meadow Cloud support"
    default y

config MEADOW_ETHNET_INCLUDE_IN_BUILD
    bool "Build Meadow and include Ethernet"
    default y
    ---help---
    This must be used with a 'defconfig' file that includes the correct Ethernet configuration.

config MEADOW_ROTARY_ENCODER
    bool "Build Meadow and include Rotary Encoder"
    default y
    ---help---
    Include Rotary Encoder code in Meadow build.

config HCOM_ESP32_COMMS
    bool "Enables HCOM file download to the ESP32"
    default y

menu "ESP32 Coprocessor Configuration"
source "configs/stm32f777zit6-meadow/src/espcp/Kconfig"
endmenu

if ARCH_BOARD_MEADOW

# See meadow-adc.c file, currently unused.
config MEADOW_ADC
    bool "Enables Meadow ADC support"

config MEADOW_HCOM
    bool "Enables Meadow HCOM support"
    default y

config MEADOW_TIMER_SUPPORT
    bool "Enables Meadow timer support"
    default n

config MEADOW_PWR_MGMT_SUPPORT
    bool "Enables Meadow power management support"
    default n

endif # ARCH_BOARD_MEADOW
```

## nuttx/configs/stm32f777zit6-meadow/src/espcp/Kconfig
```kconfig
#
# For a description of the syntax of this configuration file,
# see the file kconfig-language.txt in the NuttX tools repository.
#

config MEADOW_ESPCP_MANAGER
    bool "Enable ESP32 Coprocessor"
    default y
    ---help---
        Enable or disable ESP32 coprocessor support.

if MEADOW_ESPCP_MANAGER

config MEADOW_ESPCP_PRIORITY
    int "ESP32 coprocessor queue manager task priority"
    default 100
    ---help---
        Message queue priority for messages to be sent to the ESP32

config MEADOW_ESPCP_STACKSIZE
    int "ESP32 coprocessor stack size"
    default 4096
    ---help---
        Amount of memory reserved for the process dealing with messages for / from the ESP32.

config MEADOW_ESPCP_USE_EXTERNAL_ESP32_BOARD
    bool "Use external ESP32 chip"
    default n
    ---help---
        Use an external ESP32 for debugging purposes.

config MEADOW_ESPCP_RESET_ESP32_AT_STARTUP
    bool "Reset the ESP32 at startup?"
    default y
    ---help---
        Should the ESP32 be reset as part of the startup process.  The default for production
        is "Y".  For development it is sometimes necessary to attach a debugger to the ESP32
        and in this case resetting the chip interferes with debugging.

        For debugging set this to Y
        For production set this to N (default).
        
endif
```
