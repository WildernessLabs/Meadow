 /****************************************************************************
 * espcp_uart_monitor.c
 *
 *   Copyright (C) 2024 Wilderness Labs. All rights reserved.
 *   Author: Mark Stevens
 *
 * Redistribution and use in source and binary forms, with or without
 * modification, are permitted provided that the following conditions
 * are met:
 *
 * 1. Redistributions of source code must retain the above copyright
 *    notice, this list of conditions and the following disclaimer.
 * 2. Redistributions in binary form must reproduce the above copyright
 *    notice, this list of conditions and the following disclaimer in
 *    the documentation and/or other materials provided with the
 *    distribution.
 * 3. Neither the name NuttX nor the names of its contributors may be
 *    used to endorse or promote products derived from this software
 *    without specific prior written permission.
 *
 * THIS SOFTWARE IS PROVIDED BY THE COPYRIGHT HOLDERS AND CONTRIBUTORS
 * "AS IS" AND ANY EXPRESS OR IMPLIED WARRANTIES, INCLUDING, BUT NOT
 * LIMITED TO, THE IMPLIED WARRANTIES OF MERCHANTABILITY AND FITNESS
 * FOR A PARTICULAR PURPOSE ARE DISCLAIMED. IN NO EVENT SHALL THE
 * COPYRIGHT OWNER OR CONTRIBUTORS BE LIABLE FOR ANY DIRECT, INDIRECT,
 * INCIDENTAL, SPECIAL, EXEMPLARY, OR CONSEQUENTIAL DAMAGES (INCLUDING,
 * BUT NOT LIMITED TO, PROCUREMENT OF SUBSTITUTE GOODS OR SERVICES; LOSS
 * OF USE, DATA, OR PROFITS; OR BUSINESS INTERRUPTION) HOWEVER CAUSED
 * AND ON ANY THEORY OF LIABILITY, WHETHER IN CONTRACT, STRICT
 * LIABILITY, OR TORT (INCLUDING NEGLIGENCE OR OTHERWISE) ARISING IN
 * ANY WAY OUT OF THE USE OF THIS SOFTWARE, EVEN IF ADVISED OF THE
 * POSSIBILITY OF SUCH DAMAGE.
 *
 ****************************************************************************/

/****************************************************************************
 * Included Files
 ****************************************************************************/

#include <nuttx/config.h>

#include <nuttx/compiler.h>
#include <fcntl.h>
#include <sys/types.h>
#include <stdio.h>
#include <stdlib.h>
#include <string.h>
#include <stdint.h>
#include <stdbool.h>
#include <signal.h>
#include <time.h>
#include <crc32.h>
#include <errno.h>
#include <debug.h>
#include <nuttx/kthread.h>
#include <limits.h>

#include <arch/board/board.h>

#include <ctype.h>

#include <meadow/hcom_shared_common.h>
#include "espcp_message_dispatcher.h"
#include "espcp_coprocessor.h"
#include <meadow/meadow_thread_config.h>

/****************************************************************************
 * Uncomment the #define below to turn on debug help macros.
 ****************************************************************************/
// #define USE_MEADOW_DEBUG_HELPERS
#include <meadow/meadow_debug_helpers.h>

/****************************************************************************
 * Pre-processor Definitions
 ****************************************************************************/

/**
 * @brief Number of bytes to allocate for the incoming line of text
 *        from the UART connected to the ESP32.
 */
#define ESPCP_NETWORK_MONITOR_BUFFER_LENGTH     256

/****************************************************************************
 * Local method prototypes.
 ****************************************************************************/

static void espcp_process_ready_control_signal(const char *);
static void espcp_process_message_waiting_control_signal(const char *);
static void espcp_process_spi_ready_control_signal(const char *);

/****************************************************************************
 * Local type defintions.
 ****************************************************************************/

/**
 * @brief Names for the control signals that can be generated by the system.
 */
typedef enum espcp_control_signal_e
{
    ESPCP_CONTROL_SIGNAL_RESET = 0,
    ESPCP_CONTROL_SIGNAL_READY = 1,
    ESPCP_CONTROL_SIGNAL_MESSAGE_WAITING = 2,
    ESPCP_CONTROL_SIGNAL_SPI_INTERFACE_READY = 3,
} espcp_control_signal_t;

/**
 * @brief Structure holding the names and text for the control signals.
 */
typedef struct espcp_control_signals_s
{
    /**
     * @brief Control signal enum value
     */
    espcp_control_signal_t control_signal;

    /**
     * @brief Text used to represent the control signal.
     */
    const char *text;

    /**
     * @brief Length of the text.
     */
    const int length;

    /**
     * @brief Event handler that should be called upon successful match.
     */
    void (*event_handler)(const char *);
} espcp_control_signals_t;

/****************************************************************************
 * Private Data
 ****************************************************************************/

/**
 * @brief Should the network monitor be shut down?
 */
static bool _uart_monitor_shutting_down = false;

/**
 * @brief Is the network monitor thread running ?
 */
static bool _uart_monitor_running = false;

/**
 * @brief Thread ID for the network monitor thread.
 */
static pthread_t _uart_monitor_thread_handle = 0;

/**
 * @brief Message names and types along with the event handlers for the messages.
 * 
 * This table should be ordered with the most common messages first.  This will
 * allow the most common message types to be detected quickly.
 */
static const espcp_control_signals_t _control_signals[] =
{
    //
    //  These messages are the ones that are most regularly sent by the ESP32.
    //
    { ESPCP_CONTROL_SIGNAL_SPI_INTERFACE_READY, "SIR", 3, espcp_process_spi_ready_control_signal },
    { ESPCP_CONTROL_SIGNAL_MESSAGE_WAITING, "MW", 2, espcp_process_message_waiting_control_signal },
    //
    //  The following messages happen infrequently in a well behaved system.
    //
    { ESPCP_CONTROL_SIGNAL_RESET, "RST", 3, espcp_process_reset_control_signal },
    { ESPCP_CONTROL_SIGNAL_READY, "RDY", 3, espcp_process_ready_control_signal },
};

/****************************************************************************
 * Private Functions
 ****************************************************************************/

/****************************************************************************
 * Public Functions
 ****************************************************************************/


/****************************************************************************
 *  Name: espcp_uart_monitor_running
 *
 *  Description:
 *      It the ESP UART monitor thread running?
 *
 *  Input Parameters:
 *      None.
 *
 *  Returned Value:
 *      1 - the thread is running.
 *      0 - the thread is not running.
 *
 *  Assumptions/Limitations:
 *      None.
 *
 ****************************************************************************/
int espcp_uart_monitor_running(void)
{
    return(_uart_monitor_running ? 1 : 0);
}

/****************************************************************************
 *  Name: espcp_uart_monitor_signal_handler
 *
 *  Description:
 *      Process any signals that are sent to the network monitor thread.
 *
 *  Input Parameters:
 *      signal_number - The signal number.
 *      information - Information about the signal.
 *      context - The context of the signal.
 *
 *  Returned Value:
 *      None.
 *
 *  Assumptions/Limitations:
 *      None.
 *
 ****************************************************************************/
static void espcp_uart_monitor_signal_handler(int signal_number, FAR siginfo_t *information, FAR void *context)
{
    _uart_monitor_shutting_down = true;
}

/****************************************************************************
 *  Name: espcp_process_ready_control_signal
 *
 *  Description:
 *      Process the "+++RDY" signal from the ESP32.
 *
 *  Input Parameters:
 *      line - Line of text from the ESP32.
 *
 *  Returned Value:
 *      None.
 *
 *  Assumptions/Limitations:
 *      Case of the strings sent by the ESP32 matches those in this method.
 * 
 *      String is '\0' terminated and the '\n' character has been removed.
 *
 ****************************************************************************/
static void espcp_process_ready_control_signal(const char *line)
{
    MEADOW_TRACE_INFORMATION("+++RDY\n");
}

/****************************************************************************
 *  Name: espcp_process_message_waiting_control_signal
 *
 *  Description:
 *      Process the "+++MW" signal from the ESP32.
 *
 *  Input Parameters:
 *      line - Line of text from the ESP32.
 *
 *  Returned Value:
 *      None.
 *
 *  Assumptions/Limitations:
 *      Case of the strings sent by the ESP32 matches those in this method.
 * 
 *      String is '\0' terminated and the '\n' character has been removed.
 *
 ****************************************************************************/
static void espcp_process_message_waiting_control_signal(const char *line)
{
    MEADOW_TRACE_INFORMATION("+++MW\n");
    espcp_queue_send_response_message();
}

/****************************************************************************
 *  Name: espcp_process_spi_ready_control_signal
 *
 *  Description:
 *      Process the "+++SIR" signal from the ESP32.
 *
 *  Input Parameters:
 *      line - Line of text from the ESP32.
 *
 *  Returned Value:
 *      None.
 *
 *  Assumptions/Limitations:
 *      Case of the strings sent by the ESP32 matches those in this method.
 * 
 *      String is '\0' terminated and the '\n' character has been removed.
 *
 ****************************************************************************/
static void espcp_process_spi_ready_control_signal(const char *line)
{
    MEADOW_TRACE_INFORMATION("+++SIR\n");
    espcp_spi_interface_unlock();
}

/****************************************************************************
 *  Name: espcp_uart_monitor_process_line
 *
 *  Description:
 *      Process the line of text that has been sent by the ESP32.
 * 
 *      Control messages will all start with "+++" followed by a signal code.
 *          * MW - Message waiting (the most common message).
 *          * RST - ESP32 has just completed the reset sequence.
 * 
 *      Lines not starting with "+++" are log messages from the ESP32.
 *
 *  Input Parameters:
 *      line - Line of text from the ESP32.
 *
 *  Returned Value:
 *      None.
 *
 *  Assumptions/Limitations:
 *      Case of the strings sent by the ESP32 matches those in this method.
 * 
 *      String is '\0' terminated and the '\n' character has been removed.
 *
 ****************************************************************************/
static void espcp_uart_monitor_process_line(char *line)
{
    if (line)
    {
        if (strncmp(line, "+++", 3) == 0)
        {
            for (int index = 0; index < sizeof(_control_signals) / sizeof(espcp_control_signal_t); index++)
            {
                if (strncmp(line + 3, _control_signals[index].text, _control_signals[index].length) == 0)
                {
                    _control_signals[index].event_handler(line);
                    return;
                }
            }
        }
        else
        {
            MEADOW_TRACE_INFORMATION("ESP Log: %s\n", line);
        }
    }
}

/****************************************************************************
 *  Name: espcp_uart_monitor_thread
 *
 *  Description:
 *      Monitor the network connected to the ESP32.
 *
 *  Input Parameters:
 *      argc - Number of arguments (not used).
 *      argv - Array of arguments (not used).
 *
 *  Returned Value:
 *      NULL.
 *
 *  Assumptions/Limitations:
 *      None.
 *
 ****************************************************************************/
static void *espcp_uart_monitor_thread(void *parameters)
{
    int uart_handle = *((int *) parameters);

    if (uart_handle >= 0)
    {
        struct sigaction action;

        action.sa_sigaction = espcp_uart_monitor_signal_handler;
        action.sa_flags = SA_SIGINFO;
        sigemptyset(&action.sa_mask);

        if (sigaction(SIGINT, &action, NULL) < 0)
        {
            _uart_monitor_shutting_down = true;
            close(uart_handle);
        }
    }
    else
    {
        MEADOW_TRACE_CRITICAL("Failed to open UART %s. Error: %d\n", ESPCP_NETWORK_MONITOR_UART_NAME, errno);
        _uart_monitor_shutting_down = true;
    }

    char *line = zalloc(ESPCP_NETWORK_MONITOR_BUFFER_LENGTH);
    char *incoming_bytes = zalloc(ESPCP_NETWORK_MONITOR_BUFFER_LENGTH);
    if ((line == NULL) || (incoming_bytes == NULL))
    {
        _uart_monitor_shutting_down = true;
    }

    int buffer_index = 0;
    while (!_uart_monitor_shutting_down)
    {
        memset(incoming_bytes, 0, ESPCP_NETWORK_MONITOR_BUFFER_LENGTH);
        int number_of_bytes = read(uart_handle, incoming_bytes, ESPCP_NETWORK_MONITOR_BUFFER_LENGTH - 1);
        if (!_uart_monitor_shutting_down)
        {
            if (number_of_bytes > 0)
            {
                incoming_bytes[number_of_bytes] = '\0';
                for (int index = 0; index < number_of_bytes; index++)
                {
                    char ch = incoming_bytes[index];
                    if (ch == '\n')
                    {
                        espcp_uart_monitor_process_line(line);
                        memset(line, 0, ESPCP_NETWORK_MONITOR_BUFFER_LENGTH);
                        buffer_index = 0;
                    }
                    else
                    {
                        if (ch != '\r')
                        {
                            if (!isprint(ch))
                            {
                                ch = '.';
                            }
                            if (buffer_index < (ESPCP_NETWORK_MONITOR_BUFFER_LENGTH - 1))
                            {
                                line[buffer_index++] = ch;
                            }
                            else
                            {
                                memset(line, 0, ESPCP_NETWORK_MONITOR_BUFFER_LENGTH);
                                buffer_index = 0;
                            }
                        }
                    }
                }
            }
        }
    }
    //
    //  Tidy up.
    //
    free(line);
    free(incoming_bytes);
    close(uart_handle);
    _uart_monitor_running = false;
    // kthread_delete(0);

    return(NULL);
}

/****************************************************************************
 *  Name: espcp_uart_monitor_start
 *
 *  Description:
 *      Initialise the network communications between the ESP32 and the STM32.
 *
 *  Input Parameters:
 *      None.
 *
 *  Returned Value:
 *      OK - Success, otherwise ERROR.
 *
 *  Assumptions/Limitations:
 *      UART will be closed by the monitoring thread.
 *
 ****************************************************************************/
int espcp_uart_monitor_start(void)
{
    if (_uart_monitor_running)
    {
        return(EALREADY);
    }

    int result = ERROR;

    // if (!_uart_monitor_shutting_down)
    // {
    //     pthread_attr_t attr;
    //     struct sched_param param;

    //     param.sched_priority = ESPCP_NETWORK_MONITOR_PRIORITY;
    //     pthread_attr_init(&attr);
    //     pthread_attr_setschedparam(&attr, &param);
    //     pthread_attr_setstacksize(&attr, ESPCP_NETWORK_MONITOR_STACK_SIZE);

    //     _uart_monitor_thread_handle =  kthread_create(ESPCP_NETWORK_MONITOR_NAME, ESPCP_NETWORK_MONITOR_PRIORITY,
    //                            ESPCP_NETWORK_MONITOR_STACK_SIZE, (main_t) espcp_uart_monitor_thread, (char *const *) NULL);
    //     if (_uart_monitor_thread_handle < 0)
    //     {
    //         syslog(LOG_CRIT, "%s@%d-Failed to create %s thread. Error: %d\n",
    //                 __FILE__, __LINE__, ESPCP_NETWORK_MONITOR_NAME, result);
    //     }
    //     else
    //     {
    //         result = OK;
    //     }
    // }

    int uart_handle = open(ESPCP_NETWORK_MONITOR_UART_NAME, O_RDONLY);

    pthread_attr_t thread_attributes;
    result = pthread_attr_init(&thread_attributes);
    if (result != OK)
    {
        return (-result);
    }

    struct sched_param scheduler_parameters;
    scheduler_parameters.sched_priority = ESPCP_NETWORK_MONITOR_PRIORITY;
    result = pthread_attr_setschedparam(&thread_attributes, &scheduler_parameters);
    if (result != OK)
    {
        return (-result);
    }

    result = pthread_attr_setstacksize(&thread_attributes, ESPCP_NETWORK_MONITOR_STACK_SIZE);
    if (result != OK)
    {
        return (-result);
    }

    pthread_t thread;
    result = pthread_create(&thread, &thread_attributes, espcp_uart_monitor_thread, &uart_handle);
    if (result != OK)
    {
        return (-result);
    }

    return(result);
}

/****************************************************************************
 *  Name: espcp_uart_monitor_stop
 *
 *  Description:
 *      Stop UART monitoring.  This is required to allow HCOM to shutdown the
 *      monitoring thread and allow HCOM to talk to the ESP32 for reprogramming.
 *
 *  Input Parameters:
 *      None.
 *
 *  Returned Value:
 *      OK - Success, otherwise ERROR.
 *
 *  Assumptions/Limitations:
 *      UART will be closed by the monitoring thread.
 *
 ****************************************************************************/
int espcp_uart_monitor_stop(void)
{
    if (espcp_uart_monitor_running())
    {
        kill(_uart_monitor_thread_handle, SIGINT);
        while (espcp_uart_monitor_running())
        {
            usleep(10 * 1000);
        }
        MEADOW_TRACE_INFORMATION("ESP32 UART monitor thread stopped.\n");
    }
    else
    {
        MEADOW_TRACE_INFORMATION("ESP32 UART monitor thread is not running.\n");
    }

    return(OK);
}